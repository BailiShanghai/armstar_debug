SYStem.CPU STAR

// set endianism according to the selection
SYStem.Option BigEndian OFF

;Disable interrupts while single stepping
SYStem.Option IMASKASM ON

;Disable interrupts while HLL single stepping
SYStem.Option IMASKHLL ON
SYStem.JtagClock CTCK 1MHz

SYStem.CONFIG ETM Base E:0xE0041000
SYStem.CONFIG ITM Base E:0xE0000000
SYStem.CONFIG TPIU Base E:0xE0040000
SYStem.CONFIG.CTI Base E:0xE0042000

SYStem.CONFIG MEMORYACCESSPORT 0
system.config.ahbaccessport 0. 
SYStem.CONFIG.DEBUGPORTTYPE SWD
SYStem.Option DUALPORT ON
SYStem.MemAccess DAP
Trace.DISable

// start debugger
;IF ((Data.Long(ad:0xE000EDF0)&(1<<19))!=0x0)
;(
;  DATA.SET AD:0xE000EDF0 %long (Data.Long(AD:0xE000EDF0)|(1<<1)|(1<<0)|(0xA05F<<16))
;
;  WHILE 0 == (Data.Long(ad:0xE000EDF0)&(1<<17))
;  (
;  )
;)

SYStem.attach

if run()
break

enddo